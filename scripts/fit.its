## scripts/fit.its
```
/dts-v1/;
  
/ {
    description = "U-Boot fitImage for IX4-200D kernel";
    #address-cells = <1>;
  
    images {
        kernel-0 {
            description = "Linux Kernel";
            data = /incbin/("/vmlinuz");
            type = "kernel";
            arch = "arm";
            os = "linux";
            compression = "none";
            load = <0x00008000>;
            entry = <0x00008000>;
            hash-1 {
                algo = "sha1";
            };
        };
        fdt-0 {
            description = "Flattened Device Tree blob";
            data = /incbin/("/boot/kirkwood-iomega_ix4_200d.dtb");
            type = "flat_dt";
            arch = "arm";
            compression = "none";
            hash-1 {
                algo = "sha1";
            };
        };
        ramdisk-0 {
            description = "ramdisk";
            data = /incbin/("/initrd.img");
            type = "ramdisk";
            arch = "arm";
            os = "linux";
            compression = "none";
            hash-1 {
                algo = "sha1";
            };
        };
    };
    configurations {
        default = "conf-1";
        conf-1 {
            description = "Boot Linux kernel with FDT blob + ramdisk";
            kernel = "kernel-0";
            fdt = "fdt-0";
            ramdisk = "ramdisk-0";
            hash-1 {
                algo = "sha1";
            };
        };
    };
};
```
